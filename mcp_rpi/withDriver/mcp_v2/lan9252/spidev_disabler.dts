/dts-v1/;
/plugin/;

/ {
    compatible = "brcm,bcm2835", "brcm,bcm2711";

    fragment@0 {
        target = <&spi0>;
        __overlay__ {
            #address-cells = <1>;
            #size-cells = <0>;
            status = "okay";

            spidev@0 {
                status = "disabled";  /* Disable spidev0 to allow LAN9252 driver */
            };

            lan9252@0 {
                compatible = "microchip,lan9252";
                reg = <0>;                  /* CS0 (GPIO8) */
                spi-max-frequency = <3000000>;  /* 5 MHz */
                spi-cpol;
                spi-cpha;
                /* interrupts = <25 2>;     Optional: GPIO25 for interrupt */
                /* interrupt-parent = <&gpio>; */
            };
        };
    };
};
